## packages/lyra-overlays/lyra_overlays/overlays/Kconfig
```kconfig
mainmenu "Luckfox Lyra Device Configuration"

choice BOARD
	bool "Board"
	default BOARD_GENERIC
	help
	  Setting this option correctly will lock-in the configuration
	  options required by your board to function normally. Setting
	  this to the wrong option may prevent your board from functioning
	  properly, and in rare cases, may damage your board.

config BOARD_GENERIC
	bool "Generic RK3506 Board"

config BOARD_LYRA
	bool "Luckfox Lyra A/B"
	select HAS_BASE_UART0

config BOARD_LYRA_PLUS
	bool "Luckfox Lyra Plus"
	select HAS_BASE_UART0

config BOARD_LYRA_ULTRA
	bool "Luckfox Lyra Ultra"
	select HAS_BASE_UART0
	select HAS_BASE_TCS8563

config BOARD_LYRA_ULTRA_W
	bool "Luckfox Lyra Ultra W"
	select HAS_BASE_UART0
	select HAS_BASE_TCS8563

config BOARD_LYRA_ZERO_W
	bool "Luckfox Lyra Zero W"
	select HAS_BASE_UART0

config BOARD_LYRA_PI
	bool "Luckfox Lyra Pi A/B"
	select HAS_BASE_UART0
	select HAS_BASE_ES8311

config BOARD_LYRA_PI_W
	bool "Luckfox Lyra Pi A/B W"
	select HAS_BASE_UART0
	select HAS_BASE_ES8311

endchoice

comment "WARNING: Using generic board. Some options may break your board!"
	depends on BOARD_GENERIC

source "base/Kconfig"

source "i2c/Kconfig"
source "uart/Kconfig"
```

## packages/lyra-overlays/lyra_overlays/overlays/base/Kconfig
```kconfig
menu "Set hardware enabled in base DT for generic board (advanced)"
	visible if BOARD_GENERIC

comment "WARNING: Adding base hardware may break things!"
	depends on BOARD_GENERIC

config HAS_BASE_UART0
	bool "UART0 Enabled in Base"
	select UART0 if !MODIFY_BASE
	imply UART0

config HAS_BASE_I2C2
	bool "I2C2 Enabled in Base"
	select I2C2 if !MODIFY_BASE
	select I2C2_SCL1_SDA0 if !MODIFY_BASE
	imply I2C2
	imply I2C2_SCL1_SDA0

config HAS_BASE_ES8311
	bool "Everest ES8311 Soundcard Enabled in Base"
	select HAS_BASE_I2C2
	select BASE_ES8311 if !MODIFY_BASE
	imply BASE_ES8311

config HAS_BASE_TCS8563
	bool "TCS8563 RTC Enabled in Base"
	select HAS_BASE_I2C2
	select BASE_TCS8563 if !MODIFY_BASE
	imply BASE_TCS8563

endmenu

menu "Configure base hardware (advanced)"

config MODIFY_BASE
	bool "Allow modifying base hardware"

comment "WARNING: Disabling or changing default hardware may break things!"
	depends on MODIFY_BASE

config BASE_ES8311
	bool "Enable Everest ES8311 Soundcard"
	depends on HAS_BASE_ES8311
	select I2C2
	select I2C2_SCL1_SDA0

config BASE_TCS8563
	bool "Enable TCS8563 RTC"
	depends on HAS_BASE_TCS8563
	select I2C2
	select I2C2_SCL1_SDA0

endmenu
```

## packages/lyra-overlays/lyra_overlays/overlays/i2c/Kconfig
```kconfig
menu "I2C"

I2C_NUM = 0
I2C_COMMON = false
source "i2c/Kconfig.i2c"

I2C_NUM = 1
I2C_COMMON = false
source "i2c/Kconfig.i2c"

I2C_NUM = 2
I2C_COMMON = I2C2_SCL1_SDA0
source "i2c/Kconfig.i2c"

config I2C2_SCL1_SDA0
	bool "Use common configuration (SCL pin 1, SDA pin 0)"
	depends on I2C2

endmenu
```

## packages/lyra-overlays/lyra_overlays/overlays/i2c/Kconfig.i2c
```kconfig
config I2C$(I2C_NUM)
	bool "Enable I2C$(I2C_NUM)"

if !($(I2C_COMMON))

config I2C$(I2C_NUM)_FREQUENCY
	int "clock frequency (in Hz)"
	depends on I2C$(I2C_NUM)
	range 1000 1000000
	default 100000

config I2C$(I2C_NUM)_SCL
	int "SCL pin"
	depends on I2C$(I2C_NUM)
	range 0 31
	default 0

config I2C$(I2C_NUM)_SDA
	int "SDA pin"
	depends on I2C$(I2C_NUM)
	range 0 31
	default 0

endif
```

## packages/lyra-overlays/lyra_overlays/overlays/uart/Kconfig
```kconfig
menu "UART"

config UART0
	bool "Enable UART0"

comment "TX pin is always 22 (GPIO0_C6)"
	depends on UART0

comment "RX pin is always 23 (GPIO0_C7)"
	depends on UART0

comment "WARNING: UART0 is the default serial console!"
	depends on HAS_BASE_UART0 && !UART0

UART_NUM = 1
source "uart/Kconfig.uart"

UART_NUM = 2
source "uart/Kconfig.uart"

UART_NUM = 3
source "uart/Kconfig.uart-cstn-rstn"

UART_NUM = 4
source "uart/Kconfig.uart-cstn-rstn"

endmenu
```

## packages/lyra-overlays/overlays/uart/Kconfig.uart
```kconfig
config UART$(UART_NUM)
	bool "Enable UART$(UART_NUM)"

config UART$(UART_NUM)_TX
	int "TX pin"
	depends on UART$(UART_NUM)
	range 0 31
	default 0

config UART$(UART_NUM)_RX
	int "RX pin"
	depends on UART$(UART_NUM)
	range 0 31
	default 0
```

## packages/lyra-overlays/overlays/uart/Kconfig.uart-cstn-rstn
```kconfig
source "uart/Kconfig.uart"

config UART$(UART_NUM)_USE_CTSN
	bool "Use /CTS pin"
	depends on UART$(UART_NUM)

config UART$(UART_NUM)_CTSN
	int "/CTS pin"
	depends on UART$(UART_NUM)_USE_CTSN
	range 0 31
	default 0

config UART$(UART_NUM)_USE_RTSN
	bool "Use /RTS pin"
	depends on UART$(UART_NUM)

config UART$(UART_NUM)_RTSN
	int "/RTS pin"
	depends on UART$(UART_NUM)_USE_RTSN
	range 0 31
	default 0
```
